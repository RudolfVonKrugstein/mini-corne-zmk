## config/west.yml
```yaml
manifest:
  remotes:
    - name: my_repos
      url-base: https://github.com/RudolfVonKrugstein
    - name: zmkfirmware
      url-base: https://github.com/zmkfirmware
    - name: mouse_pull_request
      url-base: https://github.com/petejohanson
    - name: urob
      url-base: https://github.com/urob
    # Additional modules containing boards/shields/custom code can be listed here as well
    # See https://docs.zephyrproject.org/3.2.0/develop/west/manifest.html#projects
  projects:
    - name: zmk
      remote: mouse_pull_request
      revision: feat/pointers-with-input-processors
      import: app/west.yml
    - name: kbd_layout
      remote: my_repos
      revision: main
    - name: zmk-helpers
      remote: urob
      revision: main
    # - name: zmk
    #   remote: zmkfirmware
    #   revision: main
    #   import: app/west.yml
  self:
    path: config
```
